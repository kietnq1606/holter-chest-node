## dts/bindings/sensors/adi,ad8232.yaml
```yaml
description: "Analog Devices AD8232 Heart Rate Monitor Front-End"
compatible: "adi,ad8232"
include: base.yaml
properties:
  sample-timer:
    type: phandle
    required: true
    description: Dedicated hardware TIMER reserved for 500 Hz SAADC triggering
  io-channels:
    type: phandle-array
    required: true
    description: "ADC channel for the AD8232 output signal"
  lo-plus-gpios:
    type: phandle-array
    required: true
    description: "GPIO for LO+ output"
  lo-minus-gpios:
    type: phandle-array
    required: true
    description: "GPIO for LO- output"
```

## dts/bindings/sensors/bosch,bmi323.yaml
```yaml
# Copyright (c) 2023 Trackunit Corporation
# SPDX-License-Identifier: Apache-2.0

description: Bosch BMI323 inertial measurement unit
compatible: "bosch,bmi323"
include: i2c-device.yaml
on-bus: i2c

properties:
  int-gpios:
    type: phandle-array
    required: true
    description: GPIO connected to the BMI323 INT1 pin
```
